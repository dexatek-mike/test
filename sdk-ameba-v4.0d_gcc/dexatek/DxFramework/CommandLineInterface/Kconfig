## sdk-ameba-v4.0d_gcc/dexatek/DxFramework/CommandLineInterface/Kconfig
```kconfig
menuconfig DX_CONSOLE_SUPPORT
    bool "Command Line Interface"
    default y

if DX_CONSOLE_SUPPORT

comment "<empty>"

endif
```

## sdk-ameba-v4.0d_gcc/dexatek/DxFramework/DxBSP/Kconfig
```kconfig
menu "BSP"

comment "Platform Configurations (!!! MUST Check !!!)"

choice

prompt "SOC Type"
default PLAT_UNKNOWN

config PLAT_UNKNOWN
    bool "Unknown Platform"

config PLAT_TEMPLATE
    bool "Template Platform"
    select MACH_TEMPLATE

config PLAT_AMEBA_RTL8195AM
    bool "Ameba RTL8195AM Platform"

config PLAT_ESP32_S0WD
    bool "ESP32 S0WD Platform"
    select DX_ESP32_BLE_SUPPORT

config PLAT_RTS390X
    bool "RTS390X"

endchoice

if PLAT_TEMPLATE

config MACH_TEMPLATE
    bool "Template Machine"

endif

comment "Common Settings"
config WLAN0_NAME
    string "WLAN0 Name"
    default "wlan0"

endmenu
```

## sdk-ameba-v4.0d_gcc/dexatek/DxFramework/DxKeypadManager/Kconfig
```kconfig
menuconfig DX_KEYPAD_MANAGER_SUPPORT
    bool "Keypad Manager"
    default y

if DX_KEYPAD_MANAGER_SUPPORT 

config KEYPADMANAGER_WK_STACK_SIZE
    int "Stack Size - Keypad Manager Worker"
    default 384 if PLAT_AMEBA_RTL8195AM
    default 3072 if PLAT_ESP32_S0WD
    default 384 if PLAT_RTS390X
    default 384

config KEYPADMANAGER_RX_STACK_SIZE
    int "Stack Size - Keypad Manager RX"
    default 0 if PLAT_AMEBA_RTL8195AM
    default 1024 if PLAT_ESP32_S0WD
    default 0 if PLAT_RTS390X
    default 0

config KEYPADMANAGER_WK_QUEUE_SIZE
    int "Queue Size - Keypad Manager Workqueue"
    default 5

endif
```

## sdk-ameba-v4.0d_gcc/dexatek/DxFramework/DxOS/Kconfig
```kconfig
menu "OS"

comment "Platform Configurations (!!! MUST Check !!!)"

config SCAN_RESULT_WORKER_THREAD_STACK_SIZE
    depends on PLAT_RTS390X
    int "Queue Size - BLE Device Control Worker"
    default 1024

config SCAN_RESULT_WORKER_THREAD_MAX_EVENT_QUEUE
    depends on PLAT_RTS390X
    int "Queue Size - BLE Device Control Worker"
    default 2

endmenu
```

## sdk-ameba-v4.0d_gcc/dexatek/DxFramework/DxSysDebugger/Kconfig
```kconfig
menu "Debugger"

comment "Since we are using PURE print and limited, we can reduce this to 2KB"
comment "or even less depending on actual result base on RTOS and platform"
config SYSDEBUGGER_DEBUGGER_STACK_SIZE
    int "Stack Size - Debugger"
    default 896 if PLAT_AMEBA_RTL8195AM
    default 2048 if PLAT_ESP32_S0WD
    default 30720 if PLAT_RTS390X
    default 896
    help
        Since we are using PURE print and limited, we can reduce this to 2KB
        or even less depending on actual result base on RTOS and platform

comment "level: error=1, warn=2, info=3, debug=4, trace=5"
config DX_DEBUGGER_LOG_LEVEL
    int "Dexatek Debugger Log Level"
    range 0 5
    default 2
    help
        Dexatek Debug Log Level

config ENABLE_THREAD_STACK_DEBUGGING
    bool "Enable Thread Stack Debugging"
    default n
    help
        Support Dexatek Thread Stack Debugging

config ENABLE_MEMORY_USAGE_DEBUGGING
    bool "Enable Memory Usage Debugging"
    default n
    help
        Support Dexatek Memory Usage Debugging

config ENABLE_MEMORY_LEAK_DEBUGGING
    bool "Enable Memory Leak Debugging"
    default n
    help
        Support Dexatek Memory Leak Debugging

config ENABLE_CPU_USAGE_DEBUGGING
    depends on FREERTOS_GENERATE_RUN_TIME_STATS
    bool "Enable CPU Usage Debugging"
    default n
    help
        Support Dexatek CPU Usage Debugging

config ENABLE_MUTEX_DEADLOCK_DEBUGGING
    bool "Enable Mutex Deadlock Debugging"
    default n
    help
        Support Dexatek Mutex Deadlock Debugging

config ENABLE_BLE_KEEPER_DEBUGGING
    bool "Enable BLE Keeper Debugging"
    default n
    help
        Support Dexatek BLE Keeper Debugging

config ENABLE_SERVER_DEBUGGING
    bool "Enable DKServer Debugging"
    default n
    help
        Support Dexatek Server Manager Debugging

config ENABLE_MULTICAST_UDP_DEBUGGING
    bool "Enable Multicast UDP Debugging"
    default n

config ENABLE_COLORED_OUTPUT
    bool "Enable colored output"
    default n

config MEMORY_LEAK_DEBUGGING_MAXIMUM_COUNT
    int "Maximum Memory Leak Entry Count"
    depends on ENABLE_MEMORY_LEAK_DEBUGGING
    default 128

config MEMORY_LEAK_DEBUGGING_MAGIC_NUMBER
    hex "Memory Leak Debugging Maigc Number"
    depends on ENABLE_MEMORY_LEAK_DEBUGGING
    default 0xefdcba98

config MEMORY_LEAK_DEBUGGING_INTERVAL
    int "Memory Leak Debugging Interval (ms)"
    depends on ENABLE_MEMORY_LEAK_DEBUGGING
    default 30000
    help
        Memory accupied more this value will be judge as leak

config MEMORY_LEAK_DEBUGGING_TIMEDIFF_MAX
    int "Memory Leak Debugging Timediff Max (ms)"
    depends on ENABLE_MEMORY_LEAK_DEBUGGING
    default 9999999000

config MAXIMUM_DEBUGGER_THREAD_COUNT
    int "Maximum Debugger Thread Count"
    default 30

config SYS_DEBUGGER_JOB_QUEUE_DEPT
    int "Queue Size - Debugger Job"
    default 80
    help
        old setting: 20

config SYS_DEBUGGER_MAX_DUMP_BATCH_SIZE
    int "Debugger Maximum Dump Batch Size"
    default 16

config SYS_DEBUGGER_MAX_DUMPSTRING_BATCH_SIZE
    int "Debugger Maximum Dump String Batch Size"
    default 96

endmenu
```

## sdk-ameba-v4.0d_gcc/dexatek/DxFramework/HybridPeripheralManager/Kconfig
```kconfig
menuconfig DX_HYBRID_MANAGER_SUPPORT
    bool "Hybrid Peripheral Manager"
    default y

if DX_HYBRID_MANAGER_SUPPORT

config HPMANAGER_SERVER_STACK_SIZE
    int "Stack Size - HP Manager Server"
    default 1536 if PLAT_AMEBA_RTL8195AM
    default 3072 if PLAT_ESP32_S0WD
    default 1536 if PLAT_RTS390X
    default 1536

config HPMANAGER_CLIENT_STACK_SIZE
    int "Stack Size - HP Manager Client"
    default 1280 if PLAT_AMEBA_RTL8195AM
    default 3072 if PLAT_ESP32_S0WD
    default 1280 if PLAT_RTS390X
    default 1280

config HP_CMD_MESSAGE_ENTRY_SIZE
    depends on DEVICE_IS_HYBRID
    int "Single Queue Entry Maximum Size - HP Command Message"
    default 1536
    help
        Calculate by CONFIG_MAXIMUM_DEVICE_KEEPER * sizeof (DeviceGenericInfo_t)
        * 1.2

config HP_CMD_MESSAGE_QUEUE_DEPT
    depends on DEVICE_IS_HYBRID
    int "Queue Size - HP Command Message"
    default 20

endif
```

## sdk-ameba-v4.0d_gcc/dexatek/DxFramework/JobManager/Kconfig
```kconfig
menu "Job Manager"

config JOBMANAGER_TX_STACK_SIZE
    int "Stack Size - Job Manager TX"
    default 1536 if PLAT_AMEBA_RTL8195AM
    default 2048 if PLAT_ESP32_S0WD
    default 1536 if PLAT_RTS390X
    default 1536

config JOBMANAGER_WK_STACK_SIZE
    int "Stack Size - Job Manager Worker"
    default 1024 if PLAT_AMEBA_RTL8195AM
    default 3072 if PLAT_ESP32_S0WD
    default 1024 if PLAT_RTS390X
    default 1024

config MAXIMUM_JOB_ID_INFO_COUNT
    int "Maximum Job ID Info Count"
    default 10

endmenu
```

## sdk-ameba-v4.0d_gcc/dexatek/DxFramework/Kconfig
```kconfig
menu "DxFramework Configurations"

source "$PATH_MENU_ROOT/Kconfig.constants"

source "$PATH_MENU_ROOT/Kconfig.project"

source "$PATH_MENU_ROOT/Kconfig.kernel"

source "$PATH_MENU_ROOT/drivers/Kconfig"

endmenu
```

## sdk-ameba-v4.0d_gcc/dexatek/DxFramework/Kconfig.constants
```kconfig
config DXTASK_PRIORITY_IDLE
    int
    default 0

config DXTASK_PRIORITY_NORMAL
    int
    default 1

config DXTASK_PRIORITY_HIGH
    int
    default 2

config DXTASK_PRIORITY_VERY_HIGH
    int
    default 3

config DXTASK_PRIORITY_EXTREMELY_HIGH
    int
    default 4

config DXUART_PORT0
    int
    default 0

config DXUART_PORT1
    int
    default 1

config DXUART_PORT2
    int
    default 2

config DXUART_FLOWCONTROL_NONE
    int
    default 0

config DXUART_FLOWCONTROL_RTS
    int
    default 1

config DXUART_FLOWCONTROL_CTS
    int
    default 2

config DXUART_FLOWCONTROL_RTSCTS
    int
    default 3

config DXUART_PARITY_NONE
    int
    default 0

config DXUART_PARITY_ODD
    int
    default 1

config DXUART_PARITY_EVEN
    int
    default 2
```

## sdk-ameba-v4.0d_gcc/dexatek/DxFramework/Kconfig.flash
```kconfig
menu "Dexatek Flash Layout"

choice
prompt "Flash Size"
default DX_FLASH_SIZE_32MBIT

config DX_FLASH_SIZE_32MBIT
    bool "Flash Size - 32MBit"
endchoice

config DX_FLASH_SIZE
    int
    default 4096 if DX_FLASH_SIZE_32MBIT

config DX_FLASH_SIZE_TOTAL_MBITS
    int
    default 32 if DX_FLASH_SIZE_32MBIT

config DEFAULT_FLASH_SECTOR_ERASE_SIZE
    int "Flash Sector Erase Size"
    default 4096

comment "contiguous data region 1"
comment "system data backup"
comment "system data"
comment "calibration data"

config BACKUP_SECTOR
    hex "Flash Region 1 Start Address"
    default 0x01D000

config SYSTEM_DATA_SIZE
    hex "Partition Size - System Data"
    default 0x1000
    help
        default: 4KB

config CAL_DATA_SIZE
    hex "Partition Size - Calibration Data"
    default 0x1000
    help
        default: 4KB

comment "contiguous data region 2: firmware image 1"

config FIRMWARE_IMAGE_1_ADDR
    hex "Flash Region 2 Start Address"
    default 0x020000

comment "contiguous data region 3: firmware image 2"
comment "define DX_SYSINFO_FLASH_UPDATE_IMG_START_ADDR FIRMWARE_IMAGE_2_ARRD"

config FIRMWARE_IMAGE_2_ADDR
    hex "Flash Region 3 Start Address"
    default 0x120000

comment "contiguous data region 4"
comment "sub image"
comment "hp storage"

config DX_SUBIMG_FLASH_ADDR1
    hex "Flash Region 4 Start Address"
    default 0x220000

config DX_SUBIMG_FLASH_SIZE
    hex "Partition Size - Subimage"
    default 0x100000
    help
        default: 1 MB

config DX_HP_STORAGE_SIZE
    hex "Partition Size - HP Storage"
    default 0x80000
    help
        default: 512 KB

comment "contiguous data region 5"
comment "coredump"

config ESP32_COREDUMP_ADDR
    hex "Flash Region 5 Start Address"
    default 0x3DF000

config ESP32_COREDUMP_SIZE
    hex "Partition Size - Coredump"
    default 0x10000
    help
        default: 64 KB

comment "contiguous data region 6"
comment "device info 1"
comment "device info 2"
comment "system info 1"
comment "system info 2"

config DX_DEVINFO_FLASH_ADDR1
    hex "Flash Region 6 Start Address"
    default 0x3EF000

config DX_DEVINFO_FLASH_SIZE
    hex "Partition Size - Device Info"
    default 0x4000
    help
        default: 16 KB

config DX_SYSINFO_FLASH_SIZE
    hex "Partition Size - System Info"
    default 0x4000
    help
        default: 16 KB

comment "contiguous data region 7: Homekit"

config DX_HOMEKIT_SETTING_DATA_ADDR
    hex "Flash Region 7 Start Address"
    default 0x3FF000

config DX_HK_SETUP_CODE_SIZE
    int "Partition Size - Homekit Setup Code"
    default 32

config DX_HK_RESERVED_0_SIZE
    int "Partition Size - Homekit Reserved 0"
    default 224

config DX_HK_WAC_CONFIG_SIZE
    int "Partition Size - Homekit WAC Config"
    default 140

config DX_HK_KEYPAIR_SIZE
    int "Partition Size - Homekit Key Pair"
    default 68

endmenu
```

## sdk-ameba-v4.0d_gcc/dexatek/DxFramework/Kconfig.kernel
```kconfig
menu "Kernel"

source "$PATH_MENU_ROOT/DxOS/Kconfig"

source "$PATH_MENU_ROOT/DxBSP/Kconfig"

if !PLAT_UNKNOWN

source "$PATH_MENU_ROOT/DxSysDebugger/Kconfig"

source "$PATH_MENU_ROOT/SHSCommonSubModule/Kconfig"

source "$PATH_MENU_ROOT/DxDeviceInfoManager/Kconfig"

source "$PATH_MENU_ROOT/kernel/container/Kconfig"

source "$PATH_MENU_ROOT/kernel/memory/Kconfig"

source "$PATH_MENU_ROOT/kernel/storage/Kconfig"

source "$PATH_MENU_ROOT/MainStateMachine/Kconfig"

source "$PATH_MENU_ROOT/JobManager/Kconfig"

source "$PATH_MENU_ROOT/ServerManager/Kconfig"

source "$PATH_MENU_ROOT/Utils/Kconfig"

source "$PATH_MENU_ROOT/CommandLineInterface/Kconfig"

source "$PATH_MENU_ROOT/HybridPeripheralManager/Kconfig"

source "$PATH_MENU_ROOT/DxKeypadManager/Kconfig"

source "$PATH_MENU_ROOT/LEDManager/Kconfig"

source "$PATH_MENU_ROOT/MqttManager/Kconfig"

source "$PATH_MENU_ROOT/OfflineSupport/Kconfig"

source "$PATH_MENU_ROOT/ThirdPartyStack/Kconfig"

source "$PATH_MENU_ROOT/UdpCommManager/Kconfig"

source "$PATH_MENU_ROOT/WifiCommManager/Kconfig"

source "$PATH_MENU_ROOT/tests/Kconfig"

endif

endmenu
```
