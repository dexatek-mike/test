## sdk-ameba-v4.0d_gcc/dexatek/DxFramework/Kconfig.project
```kconfig
menu "Project"

config PROJECT_FW_VERSION
    string "Project Firmware Version"
    default "3.0.00"

config UART_LOG_BAUD
    int "UART Log Baud Rate"
    default 38400

comment "Wi-Fi channel/adaptivity"

config USE_WIFI_EXTENSION_API
    bool "Use WiFi extension API"
    default y

config ANONYMOUS_LOGIN_TOKEN
    string "Anonymous Login Token"
    default ""

config ANONYMOUS_LOGIN_TOKEN_TIMEOUT
    int "Anonymous Login Timeout"
    default 1800

comment "Hybrid Device Configuration"

config DEVICE_IS_HYBRID
    bool "Enable hybrid device support"
    default n
    help
        Enable hybrid device support

config HP_TAKEOVER_SUPPORT
    bool "Enable HP Take Over"
    default n
    help
        Enable HP take over support

config HYBRID_PERIPHERAL_PRODUCT_ID
    depends on DEVICE_IS_HYBRID
    hex "Hybrid Peripheral Product ID"
    default 0x98
    help
        refer to dk_Peripheral.h

config DK_SERVER_APP_ID
    string "Product APP ID"
    default "ODM-SIGMACASA-HUBRTK-0ba4f32555214"

config DK_SERVER_API_KEY
    string "Product APP KEY"
    default "ce8f2bd73b478e816a49fe68979089d"

config HP_BLE_DEVICE_KEEPERLIST_AUTO_UPDATE
    depends on DEVICE_IS_HYBRID
    bool "HP BLE Device Keeper List Auto Update"
    default n
    help
        BLE device keeper list sends to HP if device amount changed

config HP_BLE_DEVICE_PERIPHERAL_INFO_AUTO_UPDATE
    depends on DEVICE_IS_HYBRID
    bool "HP BLE Device Peripheral Info Auto Update"
    default n
    help
        BLE device PeripheralInfo sends to HP if BLE data or peripheral status changed

config GENERATE_SECURITY_KEY
    depends on DEVICE_IS_HYBRID
    bool "Generate Security Key"
    default n
    help
        BLE device PeripheralInfo sends to HP if BLE data or peripheral status changed

config SECURITY_KEY_RANDOMIZE
    depends on GENERATE_SECURITY_KEY
    int "Security Key Randomize"
    default 1
    help
        Generate Security Key using Random Number

config DATETIME_FORMAT_EU
    depends on DEVICE_IS_HYBRID
    bool "Using EU Datetime Format"
    default n
    help
        System DATETIME uses EU foramt: DD-MM-YYYY HH:MM

comment "Central Device Configuration"

config WIFI_FAIL_COUNT_BEFORE_REBOOT
    int "WiFi fail count before reboot"
    default 10
    help
        a value of 0 would not cause the the system to to reboot

config FW_AUTO_UPDATE_UPON_AVAILABLE
    bool "FW auto update upon available"
    default y
    help
        1 - Auto update
        0 - Manual Update via panel

config FW_AUTO_UPDATE_AFTER_REGISTER
    int "FW auto update after register (sec)"
    default 0

config WIFI_INFO_RETENTION_SUPPORT
    bool "WiFi keep is enabled"
    default 0


comment "Server Configuration"

config DK_SERVER_DNS_NAME
    string "server DNS name"
    default "sigmacasa.dexatekwebservice.net"
    help
        server DNS name

config DK_SERVER_API_VERSION
    string "server API version"
    default "/3.6"
    help
        server API version

config DK_QA_SERVER_DNS_NAME
    string "QA server DNS name"
    default "sigmacasaqaserver.dexatekwebservice.net"
    help
        QA server DNS name

config DK_QA_SERVER_API_VERSION
    string "QA server API version"
    default "/3.6"
    help
        old version - /SHSVR-236

config MQTT_HOST_NAME
    string "MQTT DNS name"
    default "mqtt.dexatekwebservice.net"
    help
        MQTT DNS name

config MQTT_PORT
    int "MQTT Port"
    default 8883
    help
        MQTT Port

config MQTT_QA_HOST_NAME
    string "MQTT QA DNS name"
    default "mqttqa.dexatekwebservice.net"
    help
        MQTT QA DNS name

config MQTT_QA_PORT
    int "MQTT QA Port"
    default 8883
    help
        MQTT QA Port

comment "FW Download"

config FW_DOWNLOAD_SIZE_PER_CHUNK
    int "FW download size per chunk"
    default 3072
    help
        default: 1024 * 3

comment "HW Support"

config HW_RTC_SUPPORT
    bool "HW RTC Support"
    default 0
    help
        supports PERICOM 4337 by default

comment "Alarm Support"

config ALARM_HAS_PANEL
    bool "Alarm Has Panel"
    default 0
    help
        Alarm System with Panel

endmenu
```

## sdk-ameba-v4.0d_gcc/dexatek/DxFramework/LEDManager/Kconfig
```kconfig
menuconfig DX_LED_MANAGER_SUPPORT
    bool "LED Manager"
    default y

if DX_LED_MANAGER_SUPPORT

config LED_MANAGER_STACK_SIZE
    int "Stack Size - LED Manager"
    default 384 if PLAT_AMEBA_RTL8195AM
    default 2048 if PLAT_ESP32_S0WD
    default 384 if PLAT_RTS390X
    default 384

config LED_MANAGER_JOB_QUEUE_DEPT
    int "Queue Size - LED Job"
    default 10

endif
```

## sdk-ameba-v4.0d_gcc/dexatek/DxFramework/MqttManager/Kconfig
```kconfig
menuconfig DX_MQTT_MANAGER_SUPPORT
    bool "MQTT Manager"
    default y

if DX_MQTT_MANAGER_SUPPORT

config MQTT_MANAGER_TX_STACK_SIZE
    int "Stack Size - MQTT Manager TX"
    default 3072 if PLAT_AMEBA_RTL8195AM
    default 3072 if PLAT_ESP32_S0WD
    default 3072 if PLAT_RTS390X
    default 3072

config MQTT_MANAGER_WK_STACK_SIZE
    int "Stack Size - MQTT Manager Worker"
    default 1024 if PLAT_AMEBA_RTL8195AM
    default 2048 if PLAT_ESP32_S0WD
    default 1024 if PLAT_RTS390X
    default 1024

config MQTT_MAXIMUM_DATA_LEN
    int "MQTT Data Maximum Length"
    default 1024

config MQTT_MANAGER_THREAD_QUEUE_SIZE
    int "Queue Size - MQTT Manager Topic"
    default 5

config MQTT_MANAGER_WK_QUEUE_SIZE
    int "Queue Size - MQTT Workqueue"
    default 5

config MQTT_SENDBUF_LEN
    int "MQTT Send Buffer Length"
    default 1024

config MQTT_READBUF_LEN
    int "MQTT Read Buffer Length"
    default 1024

endif
```

## sdk-ameba-v4.0d_gcc/dexatek/DxFramework/OfflineSupport/Kconfig
```kconfig
menuconfig DX_OFFLINE_SUPPORT
    bool "Offline Support"
    default y

if DX_OFFLINE_SUPPORT

comment "<empty>"

config STANDBY_IF_NO_LOGIN_INFO
    bool "enter standby mode if no login info"
    default n

endif
```

## sdk-ameba-v4.0d_gcc/dexatek/DxFramework/ServerManager/Kconfig
```kconfig
menu "Server Manager"

config SERVERMANAGER_MANAGER_TX_STACK_SIZE
    int "Stack Size - Server Manager TX"
    default 2048 if PLAT_AMEBA_RTL8195AM
    default 3072 if PLAT_ESP32_S0WD
    default 2048 if PLAT_RTS390X
    default 2048

config SERVERMANAGER_MANAGER_WK_STACK_SIZE
    int "Stack Size - Server Manager Workqueue"
    default 1280 if PLAT_AMEBA_RTL8195AM
    default 4096 if PLAT_ESP32_S0WD
    default 1280 if PLAT_RTS390X
    default 1280

config SERVERMANAGER_HTTP_TX_SIZE
    int "Stack Size - Server Manager HTTP TX"
    default 4096 if PLAT_AMEBA_RTL8195AM
    default 6144 if PLAT_ESP32_S0WD
    default 4096 if PLAT_RTS390X
    default 4096

config SERVERMANAGER_HTTP_WK_SIZE
    int "Stack Size - Server Manager HTTP Workqueue"
    default 1280 if PLAT_AMEBA_RTL8195AM
    default 8192 if PLAT_ESP32_S0WD
    default 1280 if PLAT_RTS390X
    default 1280

config MAX_JSON_ELEMENT_COUNT
    int "JSON Maximum Supported Element Count"
    default 2500 if PLAT_AMEBA_RTL8195AM
    default 500 if PLAT_ESP32_S0WD
    default 2500 if PLAT_RTS390X
    default 2500

config SRVM_THREAD_QUEUE_SIZE
    int "Queue Size - Server Manager Thread"
    range 30 50 if BLE_MANAGER_SUPPORT_NETWORK_MESH
    default 20

comment "WARNING: We increase the size to 36KB to support large container and peripherals. This is temporarily only as our data retrive mechanism need revise."
config SRVM_THREAD_BUFFER_SIZE
    int "Server Manager Thread Buffer Size"
    default 4096

config HTTP_THREAD_QUEUE_SIZE
    int "Queue Size - HTTP Thread"
    default 2

config HTTP_WORKER_QUEUE_SIZE
    int "Queue Size - HTTP Worker"
    default 3

config HTTP_BUFFER_SIZE
    int "HTTP Buffer Size"
    default 36864

config SRVM_THREAD_PRIORITY
    int
    default DXTASK_PRIORITY_NORMAL

config SERVER_MANAGER_REQ_RSP_TIMEOUT
    int "Server Manager Request/Response Timeout"
    default 20000

config SERVER_MANAGER_REQ_RSP_DEBUGGING
    bool "Server Manager Request/Response Debugging"
    default n

endmenu
```

## sdk-ameba-v4.0d_gcc/dexatek/DxFramework/ThirdPartyStack/Kconfig
```kconfig
menuconfig DX_THIRD_PARTY_SUPPORT
    bool "Third Party"
    default y

if DX_THIRD_PARTY_SUPPORT

comment "FastLZ Config"

config FASTLZ_BLOCK_SIZE
    int "The block size of FastLZ"
    range 1024 4096
    default 1024
    help
        The block size of FastLZ

endif
```

## sdk-ameba-v4.0d_gcc/dexatek/DxFramework/UdpCommManager/Kconfig
```kconfig
menuconfig DX_UDP_MANAGER_SUPPORT
    bool "UDP Manager"
    default y

if DX_UDP_MANAGER_SUPPORT

config UDP_MANAGER_TX_WK_STACK_SIZE
    int "Stack Size - UDP Manager TX Worker"
    default 1024 if PLAT_AMEBA_RTL8195AM
    default 2048 if PLAT_ESP32_S0WD
    default 1024 if PLAT_RTS390X
    default 1024

config UDP_MANAGER_TX_WK_QUEUE_SIZE
    int "Queue Size - UDP Manager TX Workqueue"
    default 20 if PLAT_AMEBA_RTL8195AM
    default 10 if PLAT_RTS390X
    default 20

config UDP_MANAGER_RX_STACK_SIZE
    int "Stack Size - UDP Manager RX Worker"
    default 1024 if PLAT_AMEBA_RTL8195AM
    default 2048 if PLAT_ESP32_S0WD
    default 1024 if PLAT_RTS390X
    default 1024

config UDP_MANAGER_CTRL_WK_STACK_SIZE
    int "Stack Size - UDP Manager Ctrl Worker"
    default 512 if PLAT_AMEBA_RTL8195AM
    default 2048 if PLAT_ESP32_S0WD
    default 512 if PLAT_RTS390X
    default 512

config UDP_MANAGER_CTRL_WK_QUEUE_DEPT
    int "Queue Size - UDP Manager Ctrl Workqueue"
    default 10

endif
```

## sdk-ameba-v4.0d_gcc/dexatek/DxFramework/WifiCommManager/Kconfig
```kconfig
menuconfig DX_WIFI_MANAGER_SUPPORT
    bool "WiFi Manager"
    default y

if DX_WIFI_MANAGER_SUPPORT

config WIFI_MANAGER_TX_STACK_SIZE
    int "Stack Size - WiFi Manager TX"
    default 1792 if PLAT_AMEBA_RTL8195AM
    default 3072 if PLAT_ESP32_S0WD
    default 61440 if PLAT_RTS390X
    default 1792

config WIFI_MANAGER_CTRL_WK_STACK_SIZE
    int "Stack Size - WiFi Manager Workqueue"
    default 1024 if PLAT_AMEBA_RTL8195AM
    default 3072 if PLAT_ESP32_S0WD
    default 1024 if PLAT_RTS390X
    default 1024

config WIFI_MANAGER_CTRL_WK_QUEUE_SIZE
    int "Queue Size - WiFi Communication Control Workqueue"
    default 10 if PLAT_AMEBA_RTL8195AM
    default 10 if PLAT_ESP32_S0WD
    default 30 if PLAT_RTS390X
    default 10

config WIFI_COMM_JOB_QUEUE_DEPT
    int "Queue Size - WiFi Communication Job"
    default 2
    help
        old setting: 1

config WIFI_COMM_MAXIMUM_JOB_DATA_SIZE
    int "WiFi Communication Maximum Job Data Size"
    default 180 if PLAT_AMEBA_RTL8195AM
    default 80 if PLAT_ESP32_S0WD
    default 180 if PLAT_RTS390X
    default 180

config MAX_WIFI_SEVERE_ERROR_COUNT
    int "Maximum WIFI Severe Error Count"
    default 10

endif
```

## sdk-ameba-v4.0d_gcc/dexatek/DxFramework/drivers/Kconfig
```kconfig
menu "Drivers"

source "$PATH_MENU_ROOT/drivers/ble/Kconfig"

source "$PATH_MENU_ROOT/drivers/zigbee/Kconfig"

endmenu
```
