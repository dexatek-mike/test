## sdk-ameba-v4.0d_gcc/dexatek/DxFramework/kernel/container/Kconfig
```kconfig
menuconfig DX_CONTAINER_MANAGER_SUPPORT
    bool "Container Manager"
    default y

if DX_CONTAINER_MANAGER_SUPPORT

config MAX_NUMBER_OF_CONTAINER_GROUPS
    hex "MAX Number of Container Groups"
    default 10

endif
```

## sdk-ameba-v4.0d_gcc/dexatek/DxFramework/kernel/memory/Kconfig
```kconfig
menu "Memory Manager"

config EXTERNAL_MEMORY_SIZE
    hex "External Memory Size"
    default 0x100000

endmenu
```

## sdk-ameba-v4.0d_gcc/dexatek/DxFramework/kernel/storage/Kconfig
```kconfig
menu "Storage Manager"

config DX_STORAGE_MANAGER_SUPPORT
    bool "Enable Dexatek Storage Manager Support"
    default n
    help
        Enable Dexatek Storage Manager Support

endmenu
```

## sdk-ameba-v4.0d_gcc/dexatek/DxFramework/tests/Kconfig
```kconfig
menuconfig DX_UNIT_TEST
    bool "Unit Test"
    default n

if DX_UNIT_TEST

config DX_UNIT_TEST_OBJECT_DICTIONARY
    bool "Unit Test: Object Dictionary"
    default y

endif
```
